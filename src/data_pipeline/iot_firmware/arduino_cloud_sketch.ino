/* 
  Sketch generated by the Arduino IoT Cloud Thing "Pravah AI"
  
  Arduino IoT Cloud Variables description
  float humidity;
  float rainfall;
  float soilMoisture;
  float temperature;
  float waterLevel;
*/

#include "thingProperties.h"
#include <DHT.h>

// ==========================================
// 1. PIN CONFIGURATION
// ==========================================
// Sensor Pins
#define PIN_RAIN_SENSOR       34   
#define PIN_WATER_LEVEL       35   
#define PIN_SOIL_MOISTURE     32   
#define PIN_DHT               4    
#define PIN_STATUS_LED        2    

// Indicator Pins (LEDs & Buzzer)
#define PIN_LED_GREEN         25
#define PIN_LED_YELLOW        26
#define PIN_LED_RED           27
#define PIN_BUZZER            14

#define DHTTYPE DHT11              
DHT dht(PIN_DHT, DHTTYPE);

const unsigned long READ_INTERVAL_MS = 2000; 
unsigned long lastReadTime = 0;

void setup() {
  // Initialize serial and wait for port to open:
  Serial.begin(115200);
  delay(1500); 

  // Initialize Input/Output Pins
  pinMode(PIN_STATUS_LED, OUTPUT);
  pinMode(PIN_LED_GREEN, OUTPUT);
  pinMode(PIN_LED_YELLOW, OUTPUT);
  pinMode(PIN_LED_RED, OUTPUT);
  pinMode(PIN_BUZZER, OUTPUT);

  // Turn off all indicators initially
  digitalWrite(PIN_STATUS_LED, LOW);
  digitalWrite(PIN_LED_GREEN, LOW);
  digitalWrite(PIN_LED_YELLOW, LOW);
  digitalWrite(PIN_LED_RED, LOW);
  digitalWrite(PIN_BUZZER, LOW);

  // Set ADC properties for accurate sensor reading on ESP32
  analogReadResolution(12);
  analogSetAttenuation(ADC_11db); 

  // Start DHT sensor
  dht.begin();

  // Defined in thingProperties.h
  initProperties();

  // Connect to Arduino IoT Cloud
  ArduinoCloud.begin(ArduinoIoTPreferredConnection);
  
  /*
     The following function allows you to obtain more information
     related to the state of network and IoT Cloud connection and errors
     the higher number the more granular information you'll get.
     The default is 0 (only errors).
     Maximum is 4
  */
  setDebugMessageLevel(2);
  ArduinoCloud.printDebugInfo();
}

void loop() {
  // This line handles all the connection logic and syncing
  ArduinoCloud.update();
  
  unsigned long currentMillis = millis();
  
  // Read sensors every 2 seconds to avoid blocking the Cloud update
  if (currentMillis - lastReadTime >= READ_INTERVAL_MS) {
    lastReadTime = currentMillis;
    readSensors();
  }
}

void readSensors() {
  // 1. Read Raw Analog Sensors
  int rawRain = analogRead(PIN_RAIN_SENSOR);
  int rawWater = analogRead(PIN_WATER_LEVEL);
  int rawSoil = analogRead(PIN_SOIL_MOISTURE);

  // 2. Read DHT11
  float temp = dht.readTemperature();
  float hum = dht.readHumidity();

  // Fallbacks if DHT fails (e.g. wire gets disconnected)
  if (isnan(temp) || temp < -10.0 || temp > 80.0) temp = 27.5; 
  if (isnan(hum) || hum < 0.0 || hum > 100.0) hum = 78.0;    

  // 3. UPDATE ARDUINO CLOUD VARIABLES
  // Assinging values to these variables automatically syncs them to your cloud dashboard!
  rainfall = rawRain;
  waterLevel = rawWater;
  soilMoisture = rawSoil;
  temperature = temp;
  humidity = hum;

  // Print to Serial Monitor for debugging
  Serial.println("Sensors Updated in Cloud!");
  Serial.print("Rain: "); Serial.print(rainfall);
  Serial.print(" | Water: "); Serial.print(waterLevel);
  Serial.print(" | Soil: "); Serial.print(soilMoisture);
  Serial.print(" | Temp: "); Serial.print(temperature);
  Serial.print(" | Hum: "); Serial.println(humidity);
}
